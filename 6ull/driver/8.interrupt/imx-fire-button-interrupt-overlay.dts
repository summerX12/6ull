/dts-v1/;
/plugin/;

#include "../imx6ul-pinfunc.h"
#include "./dt-bindings/interrupt-controller/irq.h"
#include "./dt-bindings/gpio/gpio.h"

/{
    fragment@0 {
        target-path = "/";
        __overlay__{
            button_interrupt {
                compatible = "button_interrupt";
                pinctrl-names = "default";
                pinctrl-0 = <&pinctrl_button>;
                button_gpio = <&gpio5 1 GPIO_ACTIVE_LOW>;
                status = "okay";
                interrupt-parent = <&gpio5>;
                interrupts = <1 IRQ_TYPE_EDGE_RISING>;
            };
        };
    };

    fragment@1 {
        target = <&iomuxc>;
        __overlay__{
        pinctrl_button:buttongrp {
                            fsl,pin = <
                                    MX6UL_PAD_SNVS_TAMPER1__GPIO5_IO01 0x10b0
                            >;
                        };
        };
    };
};
